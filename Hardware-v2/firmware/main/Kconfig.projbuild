## Hardware-v2/firmware/main/Kconfig.projbuild
```kconfig
menu "DigiRadio v2"

config DIGIRADIO_DUMP_DSP_EEPROM
    bool "Print the DSP self boot EEPROM to the console at boot"
    default n
    help
        For the first board: after SigmaStudio+ wrote the 25AA1024 over USBi,
        this prints it through the writer program. tools/eeprom_log_to_bin.py
        turns the log into dsp/adau1452_selfboot.bin. Slow: each bit takes
        several DSP samples, so 64 KiB takes minutes. Turn it off afterwards.

config DIGIRADIO_DUMP_DSP_EEPROM_BYTES
    int "Bytes to print"
    depends on DIGIRADIO_DUMP_DSP_EEPROM
    range 32 131072
    default 65536

endmenu
```

## Software/components/drivers/si4684/Kconfig
```kconfig
menu "Si4684 tuner"

config SI4684_EMBEDDED_IMAGES
    bool "Embed the Si4684 firmware images in the app image"
    default y
    help
        Yes: the images in Firmware/Si4684-Firmware are linked into the app
        and copied once into the flash image store (Si4684ImageStore).
        No: the app reads them from that store only, so it contains no
        proprietary code and can be published (GitHub release builds).
        A radio must have run an embedding build once before it can run
        one without the images.

endmenu
```

## Software/main/Kconfig.projbuild
```kconfig
menu "DigiRadio"

config TEST_FIRMWARE
    bool "Run minimal test_firmware instead of app_main"
    default n
    help
        Replaces normal boot with board/chip smoke tests (see test_firmware.cpp).

config I2S_SDATA_PROBE
    bool "I2S SDATA capture probe (ADAU -> BT1035 data line)"
    default n
    help
        One-shot boot-time capture: reconfigures board_pins::I2sDataOut (GPIO16)
        as I2S slave RX (using the existing BCLK/LRCLK inputs) and logs whether
        real, non-silent PCM content is present. Requires physically rewiring
        GPIO16 from its old ESP32->ADAU MP1 net to the ADAU MP6->BT1035 PCM
        input trace (or an equivalent test point) -- enabling this without the
        rewire just reads whatever GPIO16 happens to be floating/connected to.

config ESP32_I2S_TEST_TONE
    bool "ESP32-generated sine tone over the shared I2S TX channel"
    default n
    help
        Continuously writes a sine wave to esp32_i2s_sink (the same shared
        BCLK/LRCLK the Si4684 uses on its own SDATA_IN0 pin, but over
        SDATA_IN1). Diagnostic: if this sounds clean while FM/DAB is
        distorted, the ADAU1701's I2S input receiving is fine in general and
        the problem is specific to the Si4684 side. Remember the ESP32
        mixer channel is muted (-96 dB) by default in the stored audio
        profile -- raise it via PUT /api/audio/profile to actually hear
        this.

endmenu
```
